## config/boards/shields/charybdis1/Kconfig.defconfig
```kconfig
if SHIELD_CHARYBDIS1_LEFT

    config ZMK_KEYBOARD_NAME
        default "Charybdis1"

    config ZMK_SPLIT_ROLE_CENTRAL
        default y

endif

if SHIELD_CHARYBDIS1_LEFT || SHIELD_CHARYBDIS1_RIGHT

    config ZMK_SPLIT
        default y

endif
```

## config/boards/shields/charybdis1/Kconfig.shield
```kconfig
config SHIELD_CHARYBDIS1_LEFT
    def_bool $(shields_list_contains,charybdis1_left)

config SHIELD_CHARYBDIS1_RIGHT
    def_bool $(shields_list_contains,charybdis1_right)
```

## config/boards/shields/charybdis_offbrand/Kconfig.defconfig
```kconfig
if SHIELD_CHARYBDIS_OFF_LEFT

    config ZMK_KEYBOARD_NAME
        default "Charybdis Off"

    config ZMK_SPLIT_ROLE_CENTRAL
        default y

endif

if SHIELD_CHARYBDIS_OFF_LEFT || SHIELD_CHARYBDIS_OFF_RIGHT

    config ZMK_SPLIT
        default y

endif
```

## config/west.yml
```yaml
manifest:
  remotes:
    - name: zmkfirmware
      url-base: https://github.com/zmkfirmware
    - name: urob
      url-base: https://github.com/urob
    - name: victor
      url-base: https://github.com/victorlucachi
    - name: jakekausler
      url-base: https://github.com/jakekausler
  projects:
    - name: zmk
    #  remote: victor
    #  revision: pmw3610-aml
      remote: jakekausler
      revision: trackball_support
      import: app/west.yml
  self:
    path: config
```
