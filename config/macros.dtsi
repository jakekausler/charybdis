  m_user: m_user {
    compatible = "zmk,behavior-macro";
    label = "m_user";
    #binding-cells = <0>;
    bindings = <&kp J>, <&kp A>, <&kp K>, <&kp E>, <&kp K>, <&kp A>, <&kp U>, <&kp S>, <&kp L>, <&kp E>, <&kp R>;
  };
  m_pass: m_pass {
    compatible = "zmk,behavior-macro";
    label = "m_pass";
    #binding-cells = <0>;
    bindings = <&kp LS(J)>, <&kp A>, <&kp K>, <&kp E>, <&kp N0>, <&kp N2>, <&kp N1>, <&kp F>, <&kp N2>, <&kp F>, <&kp N1>, <&kp EXCL>;
  };
  m_yahoo: m_yahoo {
    compatible = "zmk,behavior-macro";
    label = "m_yahoo";
    #binding-cells = <0>;
    bindings = <&kp AT>, <&kp Y>, <&kp A>, <&kp H>, <&kp O>, <&kp O>, <&kp DOT>, <&kp C>, <&kp O>, <&kp M>;
  };
  m_gmail: m_gmail {
    compatible = "zmk,behavior-macro";
    label = "m_gmail";
    #binding-cells = <0>;
    bindings = <&kp AT>, <&kp G>, <&kp M>, <&kp A>, <&kp I>, <&kp L>, <&kp DOT>, <&kp C>, <&kp O>, <&kp M>;
  };